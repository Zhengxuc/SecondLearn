AUTOSAR XML (schema 4-2-1)
package /COM/VECTOR/CFG/WORKFLOW/SYSDESC/SYNC
  flat map FLATMAP
    4 x flat instance descriptor:
      CpLedTask: upstream-reference=EcuSwComposition.CpLedTask, ecu-extract-reference=COMPOSITIONTYPE.CpLedTask
      Cdd_SBC_UJA1169: upstream-reference=EcuSwComposition.Cdd_SBC_UJA1169, ecu-extract-reference=COMPOSITIONTYPE.Cdd_SBC_UJA1169
      Test_Swc0: upstream-reference=EcuSwComposition.Test_Swc0, ecu-extract-reference=COMPOSITIONTYPE.Test_Swc0
      Test_Swc1: upstream-reference=EcuSwComposition.Test_Swc1, ecu-extract-reference=COMPOSITIONTYPE.Test_Swc1
