AUTOSAR XML (schema 00044)
package /COM/VECTOR/CFG/WORKFLOW/SYSDESC/SYNC
  system SYSTEM: category=ECU_EXTRACT
    system mapping MAPPINGS
      data-mappings:
        data-element=CpLedTask.COMPOSITIONTYPE.RearInterLight.Bool_signal, system-signal=sig_RearInterLight
        data-element=CpLedTask.COMPOSITIONTYPE.Rear_LeftWindowPosition.u8_signal, system-signal=sig_RearLeftWindowPosition
        data-element=CpLedTask.COMPOSITIONTYPE.Rear_RightWindowPosition.u8_signal, system-signal=sig_RearRightWindowPosition
        data-element=CpLedTask.COMPOSITIONTYPE.Test_Signal.u16_Siganl, system-signal=sig_TestSignal
    root-software-compositions:
      root sw composition prototype COMPOSITIONTYPE: flat-map=FLATMAP, software-composition=COMPOSITIONTYPE
  composition sw component type COMPOSITIONTYPE  # UB:Derived from original system description
    12 x component:
      BswM: type=BswM
      ComM: type=ComM
      Det: type=Det
      EcuM: type=EcuM
      Os_OsCore0_swc: type=Os_OsCore0_swc
      DemMaster_0: type=DemMaster_0
      DemSatellite_0: type=DemSatellite_0
      Dcm: type=Dcm
      CpLedTask: type=CtLedTask
      Cdd_SBC_UJA1169: type=CddSbc
      Test_Swc0: type=Test_Swc0
      Test_Swc1: type=Test_Swc1
    connect BswM.Switch_ESH_ModeSwitch -> BswM.Notification_ESH_ModeNotification
    connect ComM.UR_CN_CAN00_06ecbb07 -> CpLedTask.UR_CN_CAN00_06ecbb07
    connect Test_Swc0.Test_Swc0_Write -> Test_Swc1.Test_Swc1_Read  # UB:Derived from original system description
    connect Test_Swc1.Test_Swc1_Write -> Test_Swc0.Test_Swc0_Read  # UB:Derived from original system description
    connect Test_Swc1.Test_Swc1_Send_Test_Signal -> CpLedTask.CtLedTask_Recive_Test_Signal  # UB:Derived from original system description
    connect Test_Swc0.Swc_Service -> Test_Swc1.Swc_Service  # UB:Derived from original system description
  end to end protection set E2EPROTECTIONSET
  port interface mapping set PORTINTERFACEMAPPINGSET
