AUTOSAR XML (schema 4-2-1)
package /Spi
  module config Spi: implementation-config-variant=VARIANT-PRE-COMPILE, module-description=Spi_Impl
    CommonPublishedInformation:
      ArReleaseMajorVersion = 4
      ArReleaseMinorVersion = 2
      ArReleaseRevisionVersion = 2
      ModuleId = 83
      SwMajorVersion = 1
      SwMinorVersion = 0
      SwPatchVersion = 1
      VendorId = 43
    SpiDriver: SpiMaxChannel=2, SpiMaxJob=2, SpiMaxSequence=2
      SpiChannel_SBC_Read (SpiChannel): SpiChannelId=0, SpiChannelType=EB, SpiDataWidth=8, SpiEbMaxLength=4, SpiIbNBuffers=1, SpiTransferStart=MSB, SpiTransferWidth=1
      SpiExternalDevice_SBC (SpiExternalDevice):
        SpiBaudrate = 100000
        SpiBaudrateAlternate = 100000
        SpiByteSwap = FALSE
        SpiCsContinous = TRUE
        SpiCsIdentifier = PCS3
        SpiCsPolarity = LOW
        SpiDataShiftEdge = LEADING
        SpiEnableCs = true
        SpiHwUnit = CSIB0
        SpiShiftClockIdleLevel = LOW
        SpiSlaveMode = false
        SpiTimeClk2Cs = 0.0001
        SpiTimeCs2Clk = 0.0001
        SpiTimeCs2Cs = 0.0001
        SpiCsSelection = CS_VIA_PERIPHERAL_ENGINE
      SpiJob_0 (SpiJob): SpiHwUnitSynchronous=SYNCHRONOUS, SpiJobId=1, SpiJobPriority=0, SpiDeviceAssignment=SpiExternalDevice_SBC
        SpiChannelList_0 (SpiChannelList): SpiChannelIndex=0, SpiChannelAssignment=SpiChannel_SBC_Read
      SpiSequence_0_SBC (SpiSequence): SpiInterruptibleSequence=false, SpiSequenceId=0, SpiJobAssignment=SpiJob_0
      SpiChannel_Test_Read (SpiChannel): SpiChannelId=1, SpiChannelType=EB, SpiDataWidth=8, SpiTransferWidth=1, SpiEbMaxLength=8, SpiIbNBuffers=1, SpiTransferStart=MSB
      SpiExternalDevice_TEST (SpiExternalDevice):
        SpiSlaveMode = false
        SpiBaudrate = 100000
        SpiBaudrateAlternate = 100000
        SpiCsIdentifier = PCS1
        SpiCsPolarity = LOW
        SpiDataShiftEdge = LEADING
        SpiEnableCs = true
        SpiHwUnit = CSIB1
        SpiShiftClockIdleLevel = LOW
        SpiTimeClk2Cs = 0.0001
        SpiTimeCs2Clk = 0.0001
        SpiTimeCs2Cs = 0.0001
        SpiCsContinous = TRUE
        SpiByteSwap = FALSE
        SpiCsSelection = CS_VIA_PERIPHERAL_ENGINE
      SpiJob_1 (SpiJob): SpiJobId=0, SpiJobPriority=0, SpiHwUnitSynchronous=SYNCHRONOUS, SpiDeviceAssignment=SpiExternalDevice_TEST
        SpiChannelList: SpiChannelIndex=0, SpiChannelAssignment=SpiChannel_Test_Read
      SpiSequence_1_TEST (SpiSequence): SpiInterruptibleSequence=false, SpiSequenceId=1, SpiJobAssignment=SpiJob_1
    SpiGeneral:
      SpiCancelApi = true
      SpiChannelBuffersAllowed = 1
      SpiDevErrorDetect = true
      SpiGlobalDmaEnable = false
      SpiHwStatusApi = true
      SpiInterruptibleSeqAllowed = false
      SpiLevelDelivered = 0
      SpiOptimizeOneJobSequences = false
      SpiOptimizedChannelsNumber = 0
      SpiOptimizedSeqNumber = 0
      SpiSupportConcurrentSyncTransmit = false
      SpiTransmitTimeout = 50000
      SpiVersionInfoApi = true
      SpiCPUClockRef = McuClockReferencePoint_LPSPI1
      SpiPhyUnit_LPSPI_1 (SpiPhyUnit):
        SpiPhyUnitAsyncMethod = PIO_FIFO
        SpiPhyUnitMapping = LPSPI_1
        SpiPhyUnitMode = SPI_MASTER
        SpiPhyUnitSync = true
        SpiPhyUnitClockRef = McuClockReferencePoint_LPSPI1
      SpiPhyUnit_LSPI0_1 (SpiPhyUnit):
        SpiPhyUnitMapping = LPSPI_0
        SpiPhyUnitMode = SPI_MASTER
        SpiPhyUnitSync = true
        SpiPhyUnitAsyncMethod = PIO_FIFO
        SpiPhyUnitClockRef = McuClockReferencePoint_LPSPI0
    SpiNonAUTOSAR:
      SpiAllowBigSizeCollections = false
      SpiDisableDemReportErrorStatus = false
      SpiEnableHWUnitAsyncMode = false
      SpiEnableUserModeSupport = false
      SpiJobStartNotificationEnable = false
    SpiPublishedInformation: SpiMaxHwUnit=0
