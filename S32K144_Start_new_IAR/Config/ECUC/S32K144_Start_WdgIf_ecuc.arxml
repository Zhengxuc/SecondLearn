AUTOSAR XML (schema 4-2-1)
package /ActiveEcuC
  module config WdgIf: implementation-config-variant=VARIANT-PRE-COMPILE, module-description=WdgIf_Impl
    WdgIfDevice:
      WdgIfDeviceIndex = 0
      WdgIfDeviceIncludeFile = Wdg.h
      WdgIfDeviceSetMode = Wdg_SetMode
      WdgIfDeviceSetTriggerCondition = Wdg_SetTriggerCondition
      WdgIfDriverRef = WdgGeneral
    WdgIfGeneral: WdgIfDevErrorDetect=true, WdgIfVersionInfoApi=false, WdgIfUseStateCombiner=false
