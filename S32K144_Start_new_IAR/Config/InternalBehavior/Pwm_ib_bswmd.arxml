AUTOSAR XML (schema 4-2-1)
package /TS_T40D2M10I1R0/Pwm_ib_bswmd/BswModuleDescriptions
  bsw module description Pwm
    bsw internal behavior PwmBehavior
      65 x exclusive area:
        PWM_EXCLUSIVE_AREA_{00..64}
