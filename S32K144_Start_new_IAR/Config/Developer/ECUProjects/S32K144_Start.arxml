AUTOSAR XML (schema 00044)
package /VehicleProject
  system System
    root-software-compositions:
      root sw composition prototype EcuSwComposition: software-composition=ECU_Composition
package /ECUCompositionTypes
  composition sw component type ECU_Composition
    4 x component:
      CpLedTask: type=CtLedTask
      Cdd_SBC_UJA1169: type=CddSbc
      Test_Swc0: type=Test_Swc0
      Test_Swc1: type=Test_Swc1
    connect Test_Swc0.Test_Swc0_Write -> Test_Swc1.Test_Swc1_Read
    connect Test_Swc1.Test_Swc1_Write -> Test_Swc0.Test_Swc0_Read
    connect Test_Swc1.Test_Swc1_Send_Test_Signal -> CpLedTask.CtLedTask_Recive_Test_Signal
    connect Test_Swc0.Swc_Service -> Test_Swc1.Swc_Service
package /EndToEndProtections
  end to end protection set EndToEndProtectionSet
