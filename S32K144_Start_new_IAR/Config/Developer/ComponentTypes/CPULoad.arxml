AUTOSAR XML (schema 00044)
package /ComponentTypes
  application sw component type CPULoad
    behavior CPULoad_InternalBehavior
      timing event TMT_CPUload_Runnable_1s: start-on-event=CPUload_Runnable_1s, period=1
      runnable CPUload_Runnable_1s
  swc implementation CPULoad_Implementation: behavior=CPULoad_InternalBehavior
